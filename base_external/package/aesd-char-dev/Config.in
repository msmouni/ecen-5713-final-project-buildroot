## base_external/package/aesd-char-dev/Config.in
```kconfig
config BR2_PACKAGE_AESD_CHAR_DEV
	bool "aesd-char-dev"
	help
	  Build to include aesd-cdev driver from AESD
```

## base_external/package/ldd/Config.in
```kconfig
config BR2_PACKAGE_LDD
	bool "ldd"
	help
	  Build to include misc-module and scull drivers from AESD
```

## base_external/package/rpi_sensors/Config.in
```kconfig
config BR2_PACKAGE_RPI_SENSORS
    bool "rpi_sensors"
    help
      A simple application for sensors data aquisition.
```

## base_external/package/rpi_web_app/Config.in
```kconfig
config BR2_PACKAGE_RPI_WEB_APP
    bool "rpi_web_app"
    depends on BR2_PACKAGE_PYTHON_FLASK
    help
      Installs the Flask-based Python web application.
```
